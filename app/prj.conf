## CMakeLists.txt
```
cmake_minimum_required(VERSION 3.13.1)

set(CONFIG_APPLICATION_DEFINED_SYSCALL true)

set(ZEPHYR_BOARD_ALIASES "boards/aliases.cmake")
set(ZEPHYR_EXTRA_MODULES "${ZMK_EXTRA_MODULES};${CMAKE_CURRENT_SOURCE_DIR}/module;${CMAKE_CURRENT_SOURCE_DIR}/keymap-module")

# Find Zephyr. This also loads Zephyr's build system.
find_package(Zephyr REQUIRED HINTS ../zephyr)
project(zmk)

zephyr_linker_sources(SECTIONS include/linker/zmk-behaviors.ld)
zephyr_linker_sources(RODATA include/linker/zmk-events.ld)

if(CONFIG_ZMK_BEHAVIOR_LOCAL_IDS)
  zephyr_linker_sources(DATA_SECTIONS include/linker/zmk-behavior-local-id-map.ld)
endif()

zephyr_syscall_header(${APPLICATION_SOURCE_DIR}/include/drivers/behavior.h)
zephyr_syscall_header(${APPLICATION_SOURCE_DIR}/include/drivers/input_processor.h)
zephyr_syscall_header(${APPLICATION_SOURCE_DIR}/include/drivers/ext_power.h)

# Add your source file to the "app" target. This must come after
# find_package(Zephyr) which defines the target.
target_include_directories(app PRIVATE include)
target_sources(app PRIVATE src/viera_led_bridge.c)
target_sources(app PRIVATE src/viera_gatt.c)
target_sources(app PRIVATE src/stdlib.c)
target_sources(app PRIVATE src/activity.c)
target_sources(app PRIVATE src/behavior.c)
target_sources_ifdef(CONFIG_ZMK_KSCAN_SIDEBAND_BEHAVIORS app PRIVATE src/kscan_sideband_behaviors.c)
target_sources(app PRIVATE src/matrix_transform.c)
target_sources(app PRIVATE src/physical_layouts.c)
target_sources(app PRIVATE src/sensors.c)
target_sources_ifdef(CONFIG_ZMK_WPM app PRIVATE src/wpm.c)
target_sources(app PRIVATE src/event_manager.c)
target_sources_ifdef(CONFIG_ZMK_PM app PRIVATE src/pm.c)
target_sources_ifdef(CONFIG_ZMK_EXT_POWER app PRIVATE src/ext_power_generic.c)
target_sources_ifdef(CONFIG_ZMK_GPIO_KEY_WAKEUP_TRIGGER app PRIVATE src/gpio_key_wakeup_trigger.c)
target_sources(app PRIVATE src/events/activity_state_changed.c)
target_sources(app PRIVATE src/events/position_state_changed.c)
target_sources(app PRIVATE src/events/sensor_event.c)
target_sources_ifdef(CONFIG_ZMK_WPM app PRIVATE src/events/wpm_state_changed.c)
target_sources_ifdef(CONFIG_USB_DEVICE_STACK app PRIVATE src/events/usb_conn_state_changed.c)
target_sources(app PRIVATE src/behaviors/behavior_reset.c)
target_sources_ifdef(CONFIG_ZMK_EXT_POWER app PRIVATE src/behaviors/behavior_ext_power.c)
target_sources_ifdef(CONFIG_ZMK_BEHAVIOR_SOFT_OFF app PRIVATE src/behaviors/behavior_soft_off.c)
add_subdirectory_ifdef(CONFIG_ZMK_POINTING src/pointing/)
if ((NOT CONFIG_ZMK_SPLIT) OR CONFIG_ZMK_SPLIT_ROLE_CENTRAL)
  target_sources(app PRIVATE src/hid.c)
  target_sources(app PRIVATE src/behaviors/behavior_key_press.c)
  target_sources_ifdef(CONFIG_ZMK_BEHAVIOR_KEY_TOGGLE app PRIVATE src/behaviors/behavior_key_toggle.c)
  target_sources_ifdef(CONFIG_ZMK_BEHAVIOR_HOLD_TAP app PRIVATE src/behaviors/behavior_hold_tap.c)
  target_sources_ifdef(CONFIG_ZMK_BEHAVIOR_STICKY_KEY app PRIVATE src/behaviors/behavior_sticky_key.c)
  target_sources(app PRIVATE src/behaviors/behavior_caps_word.c)
  target_sources(app PRIVATE src/behaviors/behavior_key_repeat.c)
  target_sources_ifdef(CONFIG_ZMK_BEHAVIOR_MACRO app PRIVATE src/behaviors/behavior_macro.c)
  target_sources(app PRIVATE src/behaviors/behavior_momentary_layer.c)
  target_sources(app PRIVATE src/behaviors/behavior_mod_morph.c)
  target_sources(app PRIVATE src/behaviors/behavior_outputs.c)
  target_sources(app PRIVATE src/behaviors/behavior_toggle_layer.c)
  target_sources(app PRIVATE src/behaviors/behavior_to_layer.c)
  target_sources(app PRIVATE src/behaviors/behavior_transparent.c)
  target_sources(app PRIVATE src/behaviors/behavior_none.c)
  target_sources(app PRIVATE src/behaviors/behavior_bl_toggle.c)
  target_sources_ifdef(CONFIG_ZMK_BEHAVIOR_SENSOR_ROTATE app PRIVATE src/behaviors/behavior_sensor_rotate.c)
  target_sources_ifdef(CONFIG_ZMK_BEHAVIOR_SENSOR_ROTATE_VAR app PRIVATE src/behaviors/behavior_sensor_rotate_var.c)
  target_sources_ifdef(CONFIG_ZMK_BEHAVIOR_SENSOR_ROTATE_COMMON app PRIVATE src/behaviors/behavior_sensor_rotate_common.c)
  target_sources_ifdef(CONFIG_ZMK_BEHAVIOR_MOUSE_KEY_PRESS app PRIVATE src/behaviors/behavior_mouse_key_press.c)
  target_sources_ifdef(CONFIG_ZMK_BEHAVIOR_STUDIO_UNLOCK app PRIVATE src/behaviors/behavior_studio_unlock.c)
  target_sources_ifdef(CONFIG_ZMK_BEHAVIOR_INPUT_TWO_AXIS app PRIVATE src/behaviors/behavior_input_two_axis.c)
  target_sources(app PRIVATE src/combo.c)
  target_sources_ifdef(CONFIG_ZMK_BEHAVIOR_TAP_DANCE app PRIVATE src/behaviors/behavior_tap_dance.c)
  target_sources(app PRIVATE src/behavior_queue.c)
  target_sources(app PRIVATE src/conditional_layer.c)
  target_sources(app PRIVATE src/endpoints.c)
  target_sources(app PRIVATE src/events/endpoint_changed.c)
  target_sources(app PRIVATE src/hid_listener.c)
  target_sources(app PRIVATE src/keymap.c)
  target_sources(app PRIVATE src/events/layer_state_changed.c)
  target_sources(app PRIVATE src/events/modifiers_state_changed.c)
  target_sources(app PRIVATE src/events/keycode_state_changed.c)
  target_sources_ifdef(CONFIG_ZMK_HID_INDICATORS app PRIVATE src/hid_indicators.c)

  if (CONFIG_ZMK_BLE)
    target_sources(app PRIVATE src/events/ble_active_profile_changed.c)
    target_sources(app PRIVATE src/behaviors/behavior_bt.c)
    target_sources(app PRIVATE src/ble.c)
    target_sources(app PRIVATE src/hog.c)
  endif()
endif()

target_sources_ifdef(CONFIG_ZMK_RGB_UNDERGLOW app PRIVATE src/behaviors/behavior_rgb_underglow.c)
target_sources_ifdef(CONFIG_ZMK_BACKLIGHT app PRIVATE src/behaviors/behavior_backlight.c)

target_sources_ifdef(CONFIG_ZMK_BATTERY_REPORTING app PRIVATE src/events/battery_state_changed.c)
target_sources_ifdef(CONFIG_ZMK_BATTERY_REPORTING app PRIVATE src/battery.c)

target_sources_ifdef(CONFIG_ZMK_HID_INDICATORS app PRIVATE src/events/hid_indicators_changed.c)

target_sources_ifdef(CONFIG_ZMK_SPLIT app PRIVATE src/events/split_peripheral_status_changed.c)
add_subdirectory_ifdef(CONFIG_ZMK_SPLIT src/split)

target_sources_ifdef(CONFIG_USB_DEVICE_STACK app PRIVATE src/usb.c)
target_sources_ifdef(CONFIG_ZMK_USB app PRIVATE src/usb_hid.c)
target_sources_ifdef(CONFIG_ZMK_RGB_UNDERGLOW app PRIVATE src/rgb_underglow.c)
target_sources_ifdef(CONFIG_ZMK_BACKLIGHT app PRIVATE src/backlight.c)
target_sources_ifdef(CONFIG_ZMK_LOW_PRIORITY_WORK_QUEUE app PRIVATE src/workqueue.c)
target_sources(app PRIVATE src/main.c)

add_subdirectory(src/display/)
add_subdirectory_ifdef(CONFIG_SETTINGS src/settings/)

if (CONFIG_ZMK_STUDIO_RPC)
  # For some reason this is failing if run from a different sub-file.
  list(APPEND CMAKE_MODULE_PATH ${ZEPHYR_BASE}/modules/nanopb)

  include(nanopb)

    # Turn off the default nanopb behavior
  set(NANOPB_GENERATE_CPP_STANDALONE OFF)

  nanopb_generate_cpp(proto_srcs proto_hdrs RELPATH ${ZEPHYR_ZMK_STUDIO_MESSAGES_MODULE_DIR}
                        ${ZEPHYR_ZMK_STUDIO_MESSAGES_MODULE_DIR}/proto/zmk/studio.proto
                        ${ZEPHYR_ZMK_STUDIO_MESSAGES_MODULE_DIR}/proto/zmk/meta.proto
                        ${ZEPHYR_ZMK_STUDIO_MESSAGES_MODULE_DIR}/proto/zmk/core.proto
                        ${ZEPHYR_ZMK_STUDIO_MESSAGES_MODULE_DIR}/proto/zmk/behaviors.proto
                        ${ZEPHYR_ZMK_STUDIO_MESSAGES_MODULE_DIR}/proto/zmk/keymap.proto
  )

  target_include_directories(app PUBLIC ${CMAKE_CURRENT_BINARY_DIR})
  target_sources(app PRIVATE ${proto_srcs} ${proto_hdrs})

  add_subdirectory(src/studio)
endif()

zephyr_cc_option(-Wfatal-errors)
```

## Kconfig
```
# Copyright (c) 2020 The ZMK Contributors
# SPDX-License-Identifier: MIT

mainmenu "ZMK Firmware"

menu "ZMK"

menu "Basic Keyboard Setup"

config ZMK_KEYBOARD_NAME
    string "Keyboard Name"

config USB_DEVICE_PRODUCT
    default ZMK_KEYBOARD_NAME

config BT_DEVICE_NAME
    default ZMK_KEYBOARD_NAME

config USB_DEVICE_VID
    default 0x1D50

config USB_DEVICE_PID
    default 0x615E

config USB_DEVICE_MANUFACTURER
    default "ZMK Project"

config BT_DIS_PNP_VID
    default 0x1D50

config BT_DIS_PNP_PID
    default 0x615E

config BT_DIS_MODEL
    default ZMK_KEYBOARD_NAME

config BT_DIS_MANUF
    default "ZMK Project"

# Hardware specific overrides

if SOC_SERIES_NRF52X

# Default on for our usage until boards implement retained bootmode.
config NRF_STORE_REBOOT_TYPE_GPREGRET
    bool
    default y

endif # SOC_SERIES_NRF52X

menu "HID"

choice ZMK_HID_REPORT_TYPE
    prompt "HID Report Type"

config ZMK_HID_REPORT_TYPE_HKRO
    bool "#-Key Roll Over (HKRO) HID Report"
    help
      Enable # key roll over for HID report. This selection is "boot keyboard" compatible
      but limits the total number of possible keys to report as held to #.

config ZMK_HID_REPORT_TYPE_NKRO
    bool "Full N-Key Roll Over (NKRO) HID Report"
    help
      Enable full N-Key Roll Over for HID output. This selection will prevent the keyboard
      from working with some BIOS/UEFI versions that only support "boot keyboard" support.
      This option also prevents using some infrequently used higher range HID usages (notably F13-F24 and INTL1-9)
      These usages can be re enabled with ZMK_HID_KEYBOARD_NKRO_EXTENDED_REPORT.

endchoice

config ZMK_HID_KEYBOARD_NKRO_EXTENDED_REPORT
    bool "Enable extended NKRO reporting"
    depends on ZMK_HID_REPORT_TYPE_NKRO
    help
      Enables higher usage range for NKRO (F13-F24 and INTL1-9).
      Please note this is not compatible with Android currently and you will get no input


if ZMK_HID_REPORT_TYPE_HKRO

config ZMK_HID_KEYBOARD_REPORT_SIZE
    int "# Keyboard Keys Reportable"

endif # ZMK_HID_REPORT_TYPE_HKRO

config ZMK_HID_CONSUMER_REPORT_SIZE
    int "# Consumer Keys Reportable"

choice ZMK_HID_CONSUMER_REPORT_USAGES
    prompt "HID Report Type"

config ZMK_HID_CONSUMER_REPORT_USAGES_FULL
    bool "Full Consumer HID Usage Support"
    help
      Enable full Consumer usage ID values to be sent to hosts. Allows for less
      frequently used usages, but has compatibability issues with some host OSes.

config ZMK_HID_CONSUMER_REPORT_USAGES_BASIC
    bool "Basic Consumer HID Usage Support"
    help
      Enable Consumer usage ID values up to "Playback Speed - Slow" to be sent to
      hosts. Allows for broader compatibability with more host OSes.

endchoice

config ZMK_HID_INDICATORS
    bool "HID Indicators"
    help
      Enable HID indicators, used for detecting state of Caps/Scroll/Num Lock,
      Kata, and Compose.

config ZMK_HID_SEPARATE_MOD_RELEASE_REPORT
    bool "Release Modifiers Separately"
    help
      Send a separate release event for the modifiers, to make sure the release
      of the modifier doesn't get recognized before the actual key's release event.

menu "Output Types"

config ZMK_USB
    bool "USB"
    depends on (!ZMK_SPLIT || (ZMK_SPLIT && ZMK_SPLIT_ROLE_CENTRAL))
    select USB
    select USB_DEVICE_STACK
    select USB_DEVICE_HID

config ZMK_USB_BOOT
    bool "USB Boot Protocol Support"
    depends on ZMK_USB
    select USB_HID_BOOT_PROTOCOL
    select USB_DEVICE_SOF

if ZMK_USB

config USB_NUMOF_EP_WRITE_RETRIES
    default 10

config USB_HID_POLL_INTERVAL_MS
    default 1

endif # ZMK_USB

menuconfig ZMK_BLE
    bool "BLE (HID over GATT)"
    select BT
    select BT_SMP
    select BT_SMP_SC_PAIR_ONLY
    select BT_SMP_APP_PAIRING_ACCEPT
    select BT_PERIPHERAL
    select BT_DIS
    imply BT_DEVICE_NAME_DYNAMIC
    imply BT_SETTINGS if !ARCH_POSIX
    imply SETTINGS if !ARCH_POSIX
    imply ZMK_BATTERY_REPORTING if !ARCH_POSIX

if ZMK_BLE

config ZMK_BLE_EXPERIMENTAL_CONN
    bool "Experimental BLE connection changes"
    help
      Enables settings that are planned to be default in future versions of ZMK
      to improve connection stability.

config ZMK_BLE_EXPERIMENTAL_SEC
    bool "Experimental BLE security changes"
    imply BT_SMP_ALLOW_UNAUTH_OVERWRITE
    help
      Enables security settings that are planned to be officially supported in the future.

config ZMK_BLE_EXPERIMENTAL_FEATURES
    bool "Experimental BLE connection and security settings/features"
    select ZMK_BLE_EXPERIMENTAL_CONN
    select ZMK_BLE_EXPERIMENTAL_SEC
    help
      Enables experimental connection changes and security features.

config ZMK_BLE_PASSKEY_ENTRY
    bool "Require passkey entry on the keyboard to complete pairing"
    select RING_BUFFER

config BT_SMP_ALLOW_UNAUTH_OVERWRITE
    imply ZMK_BLE_PASSKEY_ENTRY

config BT_CTLR_PHY_2M
    default n if ZMK_BLE_EXPERIMENTAL_CONN

# BT_TINYCRYPT_ECC is required for BT_SMP_SC_PAIR_ONLY when using HCI
config BT_TINYCRYPT_ECC
    default y if BT_HCI && !BT_CTLR

config ZMK_BLE_THREAD_STACK_SIZE
    int "BLE notify thread stack size"
    default 768

config ZMK_BLE_THREAD_PRIORITY
    int "BLE notify thread priority"
    default 5

config ZMK_BLE_KEYBOARD_REPORT_QUEUE_SIZE
    int "Max number of keyboard HID reports to queue for sending over BLE"
    default 20

config ZMK_BLE_CONSUMER_REPORT_QUEUE_SIZE
    int "Max number of consumer HID reports to queue for sending over BLE"
    default 5

config ZMK_BLE_MOUSE_REPORT_QUEUE_SIZE
    int "Max number of mouse HID reports to queue for sending over BLE"
    default 20

config ZMK_BLE_CLEAR_BONDS_ON_START
    bool "Configuration that clears all bond information from the keyboard on startup."

# HID GATT notifications sent this way are *not* picked up by Linux, and possibly others.
config BT_GATT_NOTIFY_MULTIPLE
    default n

config BT_GATT_AUTO_SEC_REQ
    default (ZMK_SPLIT_BLE && !ZMK_SPLIT_ROLE_CENTRAL)

config BT_DEVICE_APPEARANCE
    default 961

config BT_PERIPHERAL_PREF_MIN_INT
    default 6

config BT_PERIPHERAL_PREF_MAX_INT
    default 12

config BT_PERIPHERAL_PREF_LATENCY
    default 30

config BT_PERIPHERAL_PREF_TIMEOUT
    default 400

# The device name should be 16 characters or less so it fits within the
# advertising data.
config BT_DEVICE_NAME_MAX
    default 16

config ZMK_BLE_USB_EXCLUSIVE_TRANSPORT
    bool "Disconnect BLE host while USB HID data path is active"
    depends on ZMK_USB
    help
      When USB HID is ready for data transfer (device configured for HID, not
      merely VBUS present), disconnect all Bluetooth host connections, stop
      connectable advertising, and treat BLE as unavailable for keyboard routing
      so only USB delivers HID reports. Bonds are preserved; the host may
      reconnect over BLE after USB disconnect or when the HID interface is no
      longer configured.

      Wireless split halves use separate ACLs (central role on a split central);
      they are not disconnected by this option.

endif # ZMK_BLE

endmenu # Output Types

endmenu # HID

rsource "src/split/Kconfig"

endmenu # Basic Keyboard Setup

menu "Keymaps"

config ZMK_KEYMAP_LAYER_REORDERING
    bool "Layer Reordering Support"

config ZMK_KEYMAP_SETTINGS_STORAGE
    bool "Settings Save/Load"
    depends on SETTINGS
    depends on ZMK_BEHAVIOR_LOCAL_IDS

if ZMK_KEYMAP_SETTINGS_STORAGE

config ZMK_KEYMAP_LAYER_NAME_MAX_LEN
    int "Max Layer Name Length"
    default 20

endif # ZMK_KEYMAP_SETTINGS_STORAGE

endmenu # Keymaps

rsource "src/studio/Kconfig"

menu "Display/LED Options"

rsource "src/display/Kconfig"

menuconfig ZMK_RGB_UNDERGLOW
    bool "RGB Addressable LED Underglow"
    select LED_STRIP
    select ZMK_LOW_PRIORITY_WORK_QUEUE

if ZMK_RGB_UNDERGLOW

config ZMK_RGB_UNDERGLOW_EXT_POWER
    bool "RGB underglow toggling also controls external power"

config ZMK_RGB_UNDERGLOW_BRT_MIN
    int "RGB underglow minimum brightness in percent"
    range 0 100

config ZMK_RGB_UNDERGLOW_BRT_MAX
    int "RGB underglow maximum brightness in percent"
    range ZMK_RGB_UNDERGLOW_BRT_MIN 100

config ZMK_RGB_UNDERGLOW_HUE_STEP
    int "RGB underglow hue step in degrees"
    range 0 359

config ZMK_RGB_UNDERGLOW_SAT_STEP
    int "RGB underglow saturation step in percent"
    range 0 100

config ZMK_RGB_UNDERGLOW_BRT_STEP
    int "RGB underglow brightness step in percent"
    range 0 100

config ZMK_RGB_UNDERGLOW_HUE_START
    int "RGB underglow start hue value in degrees"
    range 0 359

config ZMK_RGB_UNDERGLOW_SAT_START
    int "RGB underglow start saturations value in percent"
    range 0 100

config ZMK_RGB_UNDERGLOW_BRT_START
    int "RGB underglow start brightness value in percent"
    range ZMK_RGB_UNDERGLOW_BRT_MIN ZMK_RGB_UNDERGLOW_BRT_MAX

config ZMK_RGB_UNDERGLOW_SPD_START
    int "RGB underglow start animation speed value"
    range 1 5

config ZMK_RGB_UNDERGLOW_EFF_START
    int "RGB underglow start effect int value related to the effect enum list"
    range 0 4

config ZMK_RGB_UNDERGLOW_VIERA_MIRROR_FILL
    bool "Add mirror-fill as extra underglow effect (index 4)"
    default n

config ZMK_RGB_UNDERGLOW_CAPS_INDICATOR
    bool "RGB pixel overlay for caps lock from host LED state"
    depends on ZMK_HID_INDICATORS
    default n

config ZMK_RGB_UNDERGLOW_CAPS_WORD_INDICATOR
    bool "Also light overlay pixel while caps-word is active"
    depends on ZMK_RGB_UNDERGLOW_CAPS_INDICATOR
    default n

config ZMK_RGB_UNDERGLOW_CONSTANT_PIXEL
    bool "Always-on white pixel on the underglow strip (independent of underglow on/off)"
    default y
    help
      Keeps one LED lit white at the configured index even when RGB underglow is toggled off,
      similar to standalone caps-indicator power behavior.

config ZMK_RGB_UNDERGLOW_CONSTANT_PIXEL_INDEX
    int "LED index for always-on white pixel (fallback if devicetree omits zmk,constant-pixel-index)"
    default 15
    range 0 255
    depends on ZMK_RGB_UNDERGLOW_CONSTANT_PIXEL
    help
      Zero-based LED on the underglow strip. Prefer zmk,constant-pixel-index on the zmk,underglow
      chosen strip node in devicetree.

config ZMK_RGB_UNDERGLOW_ON_START
    bool "RGB underglow starts on by default"

config ZMK_RGB_UNDERGLOW_AUTO_OFF_IDLE
    bool "Turn off RGB underglow when keyboard goes into idle state"

config ZMK_RGB_UNDERGLOW_AUTO_OFF_USB
    bool "Turn off RGB underglow when USB is disconnected"
    depends on USB_DEVICE_STACK

endif # ZMK_RGB_UNDERGLOW

menuconfig ZMK_BACKLIGHT
    bool "LED backlight"
    select LED

if ZMK_BACKLIGHT

config ZMK_BACKLIGHT_BRT_STEP
    int "Brightness step in percent"
    range 1 100

config ZMK_BACKLIGHT_BRT_START
    int "Default brightness in percent"
    range 1 100

config ZMK_BACKLIGHT_ON_START
    bool "Default backlight state"

config ZMK_BACKLIGHT_AUTO_OFF_IDLE
    bool "Turn off backlight when keyboard goes into idle state"

config ZMK_BACKLIGHT_AUTO_OFF_USB
    bool "Turn off backlight when USB is disconnected"

endif # ZMK_BACKLIGHT

endmenu # Display/LED Options

rsource "src/pointing/Kconfig"

menu "Power Management"

config ZMK_BATTERY_REPORTING
    bool "Battery level detection/reporting"
    select SENSOR
    select ZMK_LOW_PRIORITY_WORK_QUEUE
    imply BT_BAS if ZMK_BLE

if ZMK_BATTERY_REPORTING

choice ZMK_BATTERY_REPORTING_FETCH_MODE
    prompt "Battery Reporting Fetch Mode"

config ZMK_BATTERY_REPORTING_FETCH_MODE_STATE_OF_CHARGE
    bool "State of charge"

config ZMK_BATTERY_REPORTING_FETCH_MODE_LITHIUM_VOLTAGE
    bool "Lithium Voltage"

endchoice

endif # ZMK_BATTERY_REPORTING

config ZMK_IDLE_TIMEOUT
    int "Milliseconds of inactivity before entering idle state (OLED shutoff, etc)"
    default 30000

config ZMK_SLEEP
    bool "Enable deep sleep support"
    depends on HAS_POWEROFF
    select POWEROFF
    select ZMK_PM_DEVICE_SUSPEND_RESUME
    imply USB

if ZMK_SLEEP

config PM_DEVICE
    default y

config ZMK_IDLE_SLEEP_TIMEOUT
    int "Milliseconds of inactivity before entering deep sleep"
    default 900000

endif # ZMK_SLEEP

config ZMK_EXT_POWER
    bool "Enable support to control external power output"

config ZMK_PM
    bool

config ZMK_PM_DEVICE_SUSPEND_RESUME
    bool
    select ZMK_PM

config ZMK_PM_SOFT_OFF
    bool "Soft-off support"
    depends on HAS_POWEROFF
    select ZMK_PM
    select PM_DEVICE
    select ZMK_PM_DEVICE_SUSPEND_RESUME
    select POWEROFF

config ZMK_GPIO_KEY_WAKEUP_TRIGGER
    bool "Hardware supported wakeup (GPIO)"
    default y
    depends on DT_HAS_ZMK_GPIO_KEY_WAKEUP_TRIGGER_ENABLED && ZMK_PM_SOFT_OFF

# Power Management
endmenu

menu "Combo options"

config ZMK_COMBO_MAX_PRESSED_COMBOS
    int "Maximum number of currently pressed combos"
    default 4

config ZMK_COMBO_MAX_COMBOS_PER_KEY
    int "Deprecated: Max combos per key"
    default 0
    help
      Deprecated: Storage for combos is now determined automatically

config ZMK_COMBO_MAX_KEYS_PER_COMBO
    int "Deprecated: Max keys per combo"
    default 0
    help
       Deprecated: This is now auto-calculated based on `key-positions` in devicetree

# Combo options
endmenu

menu "Behavior Options"

config ZMK_BEHAVIORS_QUEUE_SIZE
    int "Maximum number of behaviors to allow queueing from a macro or other complex behavior"
    default 64

rsource "Kconfig.behaviors"

config ZMK_MACRO_DEFAULT_WAIT_MS
    int "Default time to wait (in milliseconds) before triggering the next behavior in macros"
    default 15

config ZMK_MACRO_DEFAULT_TAP_MS
    int "Default time to wait (in milliseconds) between the press and release events of a tapped behavior in macros"
    default 30

endmenu

menu "Advanced"

menu "Initialization Priorities"

if USB_DEVICE_STACK

config ZMK_USB_INIT_PRIORITY
    int "USB Init Priority"
    default 94

config ZMK_USB_HID_INIT_PRIORITY
    int "USB HID Init Priority"
    default 95

endif # USB

if ZMK_BLE || ZMK_SPLIT_BLE

config ZMK_BLE_INIT_PRIORITY
    int "BLE Init Priority"
    default 50

endif # ZMK_BLE || ZMK_SPLIT_BLE

endmenu # Initialization Priorities

config ZMK_PHYSICAL_LAYOUT_KEY_ROTATION
    bool "Support rotation of keys in physical layouts"
    default y

menuconfig ZMK_KSCAN
    bool "ZMK KScan Integration"
    default y
    select KSCAN

if ZMK_KSCAN

config ZMK_KSCAN_EVENT_QUEUE_SIZE
    int "Size of the event queue for KSCAN events to buffer events"
    default 4

endif # ZMK_KSCAN

config ZMK_KSCAN_SIDEBAND_BEHAVIORS
    bool
    default y
    depends on DT_HAS_ZMK_KSCAN_SIDEBAND_BEHAVIORS_ENABLED
    select KSCAN

if ZMK_KSCAN_SIDEBAND_BEHAVIORS

config ZMK_KSCAN_SIDEBAND_BEHAVIORS_INIT_PRIORITY
    int "Keyboard scan sideband behaviors driver init priority"
    # The default kscan init priority is 90, so be sure we are initialized later.
    default 95

endif # ZMK_KSCAN_SIDEBAND_BEHAVIORS

menu "Logging"

config ZMK_LOGGING_MINIMAL
    bool "Suppress all ZMK debug log messages"
    default false

if !ZMK_LOGGING_MINIMAL

config ZMK_LOG_LEVEL
    default 4

endif

config ZMK_USB_LOGGING
    bool "Enable USB CDC ACM logging to help debug"
    select LOG
    select USB
    select USB_DEVICE_STACK
    select USB_CDC_ACM
    select SERIAL
    select CONSOLE
    select UART_INTERRUPT_DRIVEN
    select UART_LINE_CTRL
    select UART_CONSOLE
    select USB_UART_CONSOLE

if ZMK_USB_LOGGING

choice USB_CDC_ACM_LOG_LEVEL_CHOICE
    default USB_CDC_ACM_LOG_LEVEL_OFF
endchoice

choice USB_DRIVER_LOG_LEVEL_CHOICE
    default USB_DRIVER_LOG_LEVEL_OFF
endchoice

# We do this to avoid log loop where logging to USB generates more log messages.

config USB_CDC_ACM_RINGBUF_SIZE
    default 1024

config LOG_PROCESS_THREAD_STARTUP_DELAY_MS
    default 1000

endif # ZMK_USB_LOGGING

config ZMK_RTT_LOGGING
    bool "Enable RTT logging to help debug"
    select LOG
    select DEBUG
    select ASSERT
    select USE_SEGGER_RTT
    select CONSOLE
    select RTT_CONSOLE

if ZMK_RTT_LOGGING

config SEGGER_RTT_BUFFER_SIZE_UP
    default 8192

endif # ZMK_RTT_LOGGING

if ZMK_USB_LOGGING || ZMK_RTT_LOGGING

config LOG_BUFFER_SIZE
    default 8192

config LOG_PROCESS_THREAD_SLEEP_MS
    default 100

endif # ZMK_USB_LOGGING || ZMK_RTT_LOGGING

endmenu # Logging

if SETTINGS

config ZMK_SETTINGS_RESET_ON_START
    bool "Delete all persistent settings when the keyboard boots"

if ZMK_SETTINGS_RESET_ON_START

config ZMK_SETTINGS_RESET_ON_START_INIT_PRIORITY
    int "Settings Reset ON Start Initialization Priority"
    default 60
    help
      Initialization priority for the settings reset on start. Must be lower priority/
      higher value than FLASH_INIT_PRIORITY if using the NVS/Flash settings backend.

endif # ZMK_SETTINGS_RESET_ON_START

config ZMK_SETTINGS_SAVE_DEBOUNCE
    int "Milliseconds to debounce settings saves"
    default 60000

endif # SETTINGS

config ZMK_BATTERY_REPORT_INTERVAL
    depends on ZMK_BATTERY_REPORTING
    int "Battery level report interval in seconds"

config ZMK_LOW_PRIORITY_WORK_QUEUE
    bool "Work queue for low priority items"

if ZMK_LOW_PRIORITY_WORK_QUEUE

config ZMK_LOW_PRIORITY_THREAD_STACK_SIZE
    int "Low priority thread stack size"
    default 768

config ZMK_LOW_PRIORITY_THREAD_PRIORITY
    int "Low priority thread priority"
    default 10

endif # ZMK_LOW_PRIORITY_WORK_QUEUE

endmenu # Advanced

endmenu # ZMK

config KERNEL_BIN_NAME
    default "zmk"

config REBOOT
    default y

config USB_DEVICE_STACK
    default y if HAS_HW_NRF_USBD

config FPU
    default CPU_HAS_FPU

config ZMK_WPM
    bool "Calculate WPM"

config ZMK_KEYMAP_SENSORS
    bool "Enable Keymap Sensors support"
    default y
    depends on DT_HAS_ZMK_KEYMAP_SENSORS_ENABLED
    select SENSOR

if ZMK_KEYMAP_SENSORS

config ZMK_KEYMAP_SENSORS_DEFAULT_TRIGGERS_PER_ROTATION
    int "Default triggers per rotation"
    help
      Unless overridden for a sensor in the board/shield/devicetree, this value
      determines how many times to trigger the bound behavior per full rotation.
      For tactile encoders with detents, this usually should match the number of
      detents per rotation of the encoder.
    default 20

endif # ZMK_KEYMAP_SENSORS

choice CBPRINTF_IMPLEMENTATION
    default CBPRINTF_NANO

endchoice

config ZMK_CAPS_LED_INDEX
    int "Caps lock RGB pixel index (fallback if devicetree omits zmk,caps-lock-pixel-index)"
    default 30
    range 0 255
    depends on ZMK_RGB_UNDERGLOW_CAPS_INDICATOR
    help
      Zero-based LED on the underglow strip. Prefer setting zmk,caps-lock-pixel-index on the
      zmk,underglow chosen strip node in devicetree.

# VIERA app options
menu "VIERA Options"

config VIERA_GATT_LOG_LEVEL
    int "VIERA GATT log level (0=ERR..4=DBG)"
    range 0 4
    default 3

config VIERA_FW_VERSION
    string "Firmware version string"
    default "0.1.0"

config VIERA_BOOT_GPREGRET_VALUE
    hex "UF2 bootloader GPREGRET value"
    default 0x57

endmenu

module = ZMK
module-str = zmk
source "subsys/logging/Kconfig.template.log_config"

# This loads ZMK's internal board and shield Kconfigs
rsource "boards/Kconfig"
rsource "boards/shields/*/Kconfig.defconfig"
rsource "boards/shields/*/Kconfig.shield"

# This loads custom shields defconfigs (from BOARD_ROOT)
# Duplicated from Kconfig.zephyr
osource "$(KCONFIG_BINARY_DIR)/Kconfig.shield.defconfig"

source "$(BOARD_DIR)/Kconfig.defconfig"

# This loads board and shield Kconfigs found under zmk-config/config/
osource "$(ZMK_CONFIG)/boards/shields/*/Kconfig.defconfig"
osource "$(ZMK_CONFIG)/boards/shields/*/Kconfig.shield"

# This loads ZMK's sensible defaults
rsource "Kconfig.defaults"

source "Kconfig.zephyr"
```

## Kconfig.defaults
```
# Copyright (c) 2024 The ZMK Contributors
# SPDX-License-Identifier: MIT

config SYSTEM_WORKQUEUE_STACK_SIZE
    default 2048 if SOC_RP2040
    default 2048 if ZMK_BLE

# HID
if ZMK_HID_REPORT_TYPE_HKRO

config ZMK_HID_KEYBOARD_REPORT_SIZE
    default 6

endif

config ZMK_HID_CONSUMER_REPORT_SIZE
    default 6

# Behaviors

if ZMK_BEHAVIOR_HOLD_TAP

config ZMK_BEHAVIOR_HOLD_TAP_MAX_HELD
    default 10

config ZMK_BEHAVIOR_HOLD_TAP_MAX_CAPTURED_EVENTS
    default 40

endif

if ZMK_BEHAVIOR_STICKY_KEY

config ZMK_BEHAVIOR_STICKY_KEY_MAX_HELD
    default 10

endif

if ZMK_BEHAVIOR_TAP_DANCE

config ZMK_BEHAVIOR_TAP_DANCE_MAX_HELD
    default 10

endif

# Underglow
if ZMK_RGB_UNDERGLOW

# This default value cuts down on tons of excess .conf files, if you're using GPIO, manually disable this
config SPI
    default y

config ZMK_RGB_UNDERGLOW_EXT_POWER
    default y

config ZMK_RGB_UNDERGLOW_BRT_MIN
    default 0

config ZMK_RGB_UNDERGLOW_BRT_MAX
    default 10

config ZMK_RGB_UNDERGLOW_HUE_STEP
    default 10

config ZMK_RGB_UNDERGLOW_SAT_STEP
    default 10

config ZMK_RGB_UNDERGLOW_BRT_STEP
    default 2

config ZMK_RGB_UNDERGLOW_HUE_START
    default 0

config ZMK_RGB_UNDERGLOW_SAT_START
    default 100

config ZMK_RGB_UNDERGLOW_BRT_START
    default ZMK_RGB_UNDERGLOW_BRT_MAX

config ZMK_RGB_UNDERGLOW_SPD_START
    default 3

config ZMK_RGB_UNDERGLOW_EFF_START
    default 0

config ZMK_RGB_UNDERGLOW_ON_START
    default y

endif # ZMK_RGB_UNDERGLOW

# Backlight
if ZMK_BACKLIGHT

config ZMK_BACKLIGHT_BRT_STEP
    default 20

config ZMK_BACKLIGHT_BRT_START
    default 40

config ZMK_BACKLIGHT_ON_START
    default y

endif # ZMK_BACKLIGHT

# Ext_power
config ZMK_EXT_POWER
    default y

# Battery
config ZMK_BATTERY_REPORT_INTERVAL
    default 60

# Imports
rsource "src/split/Kconfig.defaults"
```

## west.yml
```
manifest:
  remotes:
    - name: zephyrproject-rtos
      url-base: https://github.com/zephyrproject-rtos
    - name: zmkfirmware
      url-base: https://github.com/zmkfirmware
  projects:
    - name: zephyr
      remote: zmkfirmware
      revision: v4.1.0+zmk-fixes
      clone-depth: 1
      import:
        name-blocklist:
          - ci-tools
          - hal_altera
          - hal_cypress
          - hal_infineon
          - hal_microchip
          - hal_nxp
          - hal_openisa
          - hal_silabs
          - hal_xtensa
          - hal_st
          - hal_ti
          - loramac-node
          - mcuboot
          - mcumgr
          - net-tools
          - openthread
          - edtt
          - trusted-firmware-m
    - name: nanopb
      revision: 8c60555d6277a0360c876bd85d491fc4fb0cd74a
      path: modules/lib/nanopb
      remote: zmkfirmware
    - name: zmk-studio-messages
      revision: 6cb4c283e76209d59c45fbcb218800cd19e9339d
      path: modules/msgs/zmk-studio-messages
      remote: zmkfirmware
  self:
    west-commands: scripts/west-commands.yml
```

## prj.conf
```kconfig
CONFIG_APPLICATION_DEFINED_SYSCALL=y
CONFIG_BT=y
CONFIG_BT_PERIPHERAL=y
CONFIG_BT_GATT_CLIENT=n
CONFIG_USB_DEVICE_VID=0x1209
CONFIG_USB_DEVICE_PID=0xA11A
CONFIG_VIERA_GATT_LOG_LEVEL=3
CONFIG_VIERA_FW_VERSION="0.1.0"
CONFIG_VIERA_BOOT_GPREGRET_VALUE=0xB1
CONFIG_BT_DEVICE_NAME="VIERA"
CONFIG_ZMK_BLE_USB_EXCLUSIVE_TRANSPORT=y
```

## dts/bindings/behaviors/zmk,behavior-bl-toggle.yaml
```yaml
# Copyright (c) 2025
# SPDX-License-Identifier: MIT

description: Backlight toggle behavior

compatible: "zmk,behavior-bl-toggle"

properties:
  label:
    type: string
    required: true
  "#binding-cells":
    type: int
    const: 0
    required: true
```

## dts/bindings/led_strip/worldsemi,ws2812-spi.yaml
```yaml
# SPDX-License-Identifier: Apache-2.0
# Extends Zephyr's ws2812-spi binding with optional ZMK underglow properties.
# Merged with the base binding when the devicetree is processed.

compatible: "worldsemi,ws2812-spi"

properties:
  zmk,caps-lock-pixel-index:
    type: int
    description: |
      Zero-based LED index on this strip for the caps lock / caps word RGB overlay.
      When omitted, CONFIG_ZMK_CAPS_LED_INDEX is used.

  zmk,constant-pixel-index:
    type: int
    description: |
      Zero-based LED index for the always-on white pixel (CONFIG_ZMK_RGB_UNDERGLOW_CONSTANT_PIXEL).
      When omitted, CONFIG_ZMK_RGB_UNDERGLOW_CONSTANT_PIXEL_INDEX is used.
```

## include/viera_effects.h
```c
#pragma once

#include <zephyr/kernel.h>

#define VIERA_EFF_SOLID 0
#define VIERA_EFF_BREATHE 1
#define VIERA_EFF_SPECTRUM 2
#define VIERA_EFF_SWIRL 3
#define VIERA_EFF_MIRROR_FILL 4

#if IS_ENABLED(CONFIG_ZMK_RGB_UNDERGLOW_VIERA_MIRROR_FILL)
#define VIERA_EFF_NUMBER 5
#else
#define VIERA_EFF_NUMBER 4
#endif
```

## src/backlight.c
```c
/*
 * Copyright (c) 2021 The ZMK Contributors
 *
 * SPDX-License-Identifier: MIT
 */

#include <zephyr/device.h>
#include <zephyr/devicetree.h>
#include <zephyr/drivers/led.h>
#include <zephyr/init.h>
#include <zephyr/kernel.h>

#include <zephyr/logging/log.h>
#include <zephyr/settings/settings.h>

#include <zmk/activity.h>
#include <zmk/backlight.h>
#include <zmk/usb.h>
#include <zmk/event_manager.h>
#include <zmk/events/activity_state_changed.h>
#include <zmk/events/usb_conn_state_changed.h>

LOG_MODULE_DECLARE(zmk, CONFIG_ZMK_LOG_LEVEL);

BUILD_ASSERT(DT_HAS_CHOSEN(zmk_backlight),
             "CONFIG_ZMK_BACKLIGHT is enabled but no zmk,backlight chosen node found");

static const struct device *const backlight_dev = DEVICE_DT_GET(DT_CHOSEN(zmk_backlight));

#define CHILD_COUNT(...) +1
#define DT_NUM_CHILD(node_id) (DT_FOREACH_CHILD(node_id, CHILD_COUNT))

#define BACKLIGHT_NUM_LEDS (DT_NUM_CHILD(DT_CHOSEN(zmk_backlight)))

#define BRT_MAX 100

struct backlight_state {
    uint8_t brightness;
    bool on;
};

static struct backlight_state state = {.brightness = CONFIG_ZMK_BACKLIGHT_BRT_START,
                                       .on = IS_ENABLED(CONFIG_ZMK_BACKLIGHT_ON_START)};
static bool backlight_sleeping;
static bool backlight_on_before_sleep;

static int zmk_backlight_update(void) {
    uint8_t brt = zmk_backlight_get_brt();
    LOG_DBG("Update backlight brightness: %d%%", brt);

    for (int i = 0; i < BACKLIGHT_NUM_LEDS; i++) {
        int rc = led_set_brightness(backlight_dev, i, brt);
        if (rc != 0) {
            LOG_ERR("Failed to update backlight LED %d: %d", i, rc);
            return rc;
        }
    }
    return 0;
}

#if IS_ENABLED(CONFIG_SETTINGS)
static int backlight_settings_load_cb(const char *name, size_t len, settings_read_cb read_cb,
                                      void *cb_arg) {
    const char *next;
    if (settings_name_steq(name, "state", &next) && !next) {
        if (len != sizeof(state)) {
            return -EINVAL;
        }

        int rc = read_cb(cb_arg, &state, sizeof(state));
        if (rc >= 0) {
            rc = zmk_backlight_update();
        }

        return MIN(rc, 0);
    }
    return -ENOENT;
}

SETTINGS_STATIC_HANDLER_DEFINE(backlight, "backlight", NULL, backlight_settings_load_cb, NULL,
                               NULL);

static void backlight_save_work_handler(struct k_work *work) {
    settings_save_one("backlight/state", &state, sizeof(state));
}

static struct k_work_delayable backlight_save_work;
#endif

static int zmk_backlight_init(void) {
    if (!device_is_ready(backlight_dev)) {
        LOG_ERR("Backlight device \"%s\" is not ready", backlight_dev->name);
        return -ENODEV;
    }

#if IS_ENABLED(CONFIG_SETTINGS)
    k_work_init_delayable(&backlight_save_work, backlight_save_work_handler);
#endif
#if IS_ENABLED(CONFIG_ZMK_BACKLIGHT_AUTO_OFF_USB)
    state.on = zmk_usb_is_powered();
#endif
    return zmk_backlight_update();
}

static int zmk_backlight_update_and_save(void) {
    int rc = zmk_backlight_update();
    if (rc != 0) {
        return rc;
    }

#if IS_ENABLED(CONFIG_SETTINGS)
    int ret = k_work_reschedule(&backlight_save_work, K_MSEC(CONFIG_ZMK_SETTINGS_SAVE_DEBOUNCE));
    return MIN(ret, 0);
#else
    return 0;
#endif
}

int zmk_backlight_on(void) {
    state.brightness = MAX(state.brightness, CONFIG_ZMK_BACKLIGHT_BRT_STEP);
    state.on = true;
    return zmk_backlight_update_and_save();
}

int zmk_backlight_off(void) {
    state.on = false;
    return zmk_backlight_update_and_save();
}

int zmk_backlight_toggle(void) { return state.on ? zmk_backlight_off() : zmk_backlight_on(); }

bool zmk_backlight_is_on(void) { return state.on; }

int zmk_backlight_set_brt(uint8_t brightness) {
    state.brightness = MIN(brightness, BRT_MAX);
    state.on = (state.brightness > 0);
    return zmk_backlight_update_and_save();
}

uint8_t zmk_backlight_get_brt(void) { return state.on ? state.brightness : 0; }

uint8_t zmk_backlight_calc_brt(int direction) {
    int brt = state.brightness + (direction * CONFIG_ZMK_BACKLIGHT_BRT_STEP);
    return CLAMP(brt, 0, BRT_MAX);
}

uint8_t zmk_backlight_calc_brt_cycle(void) {
    if (state.brightness == BRT_MAX) {
        return 0;
    } else {
        return zmk_backlight_calc_brt(1);
    }
}

#if IS_ENABLED(CONFIG_ZMK_BACKLIGHT_AUTO_OFF_IDLE) || IS_ENABLED(CONFIG_ZMK_BACKLIGHT_AUTO_OFF_USB)
static int backlight_auto_state(bool *prev_state, bool new_state) {
    if (state.on == new_state) {
        return 0;
    }
    state.on = new_state && *prev_state;
    *prev_state = !new_state;
    return zmk_backlight_update();
}

static int backlight_event_listener(const zmk_event_t *eh) {

#if IS_ENABLED(CONFIG_ZMK_BACKLIGHT_AUTO_OFF_IDLE)
    if (as_zmk_activity_state_changed(eh)) {
        static bool prev_state = false;
        return backlight_auto_state(&prev_state, zmk_activity_get_state() == ZMK_ACTIVITY_ACTIVE);
    }
#endif

#if IS_ENABLED(CONFIG_ZMK_BACKLIGHT_AUTO_OFF_USB)
    if (as_zmk_usb_conn_state_changed(eh)) {
        static bool prev_state = false;
        return backlight_auto_state(&prev_state, zmk_usb_is_powered());
    }
#endif

    return -ENOTSUP;
}

ZMK_LISTENER(backlight, backlight_event_listener);
#endif // IS_ENABLED(CONFIG_ZMK_BACKLIGHT_AUTO_OFF_IDLE) ||
       // IS_ENABLED(CONFIG_ZMK_BACKLIGHT_AUTO_OFF_USB)

#if IS_ENABLED(CONFIG_ZMK_BACKLIGHT_AUTO_OFF_IDLE)
ZMK_SUBSCRIPTION(backlight, zmk_activity_state_changed);
#endif

#if IS_ENABLED(CONFIG_ZMK_BACKLIGHT_AUTO_OFF_USB)
ZMK_SUBSCRIPTION(backlight, zmk_usb_conn_state_changed);
#endif

SYS_INIT(zmk_backlight_init, APPLICATION, CONFIG_APPLICATION_INIT_PRIORITY);

static int backlight_sleep_event_listener(const zmk_event_t *eh) {
    if (!as_zmk_activity_state_changed(eh)) {
        return -ENOTSUP;
    }

    const bool sleeping = zmk_activity_get_state() == ZMK_ACTIVITY_SLEEP;
    if (sleeping == backlight_sleeping) {
        return 0;
    }

    backlight_sleeping = sleeping;

    if (sleeping) {
        backlight_on_before_sleep = state.on;
        state.on = false;
        return zmk_backlight_update();
    }

    state.on = backlight_on_before_sleep;
    return zmk_backlight_update();
}

ZMK_LISTENER(backlight_sleep, backlight_sleep_event_listener);
ZMK_SUBSCRIPTION(backlight_sleep, zmk_activity_state_changed);
```

## src/capslock_rgb_effect.c
```c
#include <zephyr/kernel.h>
#include <zephyr/logging/log.h>
LOG_MODULE_DECLARE(zmk, CONFIG_ZMK_LOG_LEVEL);

#if IS_ENABLED(CONFIG_ZMK_RGB_UNDERGLOW) && IS_ENABLED(CONFIG_ZMK_HID_INDICATORS)

#include <zmk/event_manager.h>
#include <zmk/events/hid_indicators_changed.h>
#include <zmk/rgb_underglow.h>
#include <zmk/hid_indicators_types.h>
#include <zephyr/sys/util.h>

/* HID LED report: bit 0 = Num Lock, bit 1 = Caps Lock, bit 2 = Scroll Lock */
#define CAPS_LOCK_BIT BIT(1)

static bool s_backlight_on = true;

static void apply_caps_state(bool caps_on) {
    if (!s_backlight_on) {
        zmk_rgb_underglow_off();
        return;
    }

    if (caps_on) {
        zmk_rgb_underglow_on();
        struct zmk_led_hsb color = { .h = 0, .s = 0, .b = 100 };
        zmk_rgb_underglow_set_hsb(color);
    } else {
        zmk_rgb_underglow_off();
    }
}

static int capslock_rgb_listener(const zmk_event_t *eh) {
    const struct zmk_hid_indicators_changed *ev =
        as_zmk_hid_indicators_changed(eh);

    if (!ev) {
        return ZMK_EV_EVENT_BUBBLE;
    }

    bool caps_on = ev->indicators & CAPS_LOCK_BIT;
    apply_caps_state(caps_on);

    return ZMK_EV_EVENT_BUBBLE;
}

ZMK_LISTENER(capslock_rgb, capslock_rgb_listener);
ZMK_SUBSCRIPTION(capslock_rgb, zmk_hid_indicators_changed);

#endif /* CONFIG_ZMK_RGB_UNDERGLOW && CONFIG_ZMK_HID_INDICATORS */
```

## src/underglow_capslock_white_rest.c
```c
#include <zephyr/device.h>
#include <zephyr/kernel.h>
#include <zmk/behavior.h>
#include <zmk/underglow.h>

static int custom_effect_update(struct led_rgb *pixels, size_t count) {
    for (int i = 0; i < count; i++) {
        pixels[i].r = 255;
        pixels[i].g = 255;
        pixels[i].b = 255;
    }

    if (zmk_hid_caps_word_active() || zmk_hid_get_keyboard_leds() & HID_LED_CAPS_LOCK) {
        pixels[5].r = 0;
        pixels[5].g = 255;
        pixels[5].b = 0;
    }

    return 0;
}

ZMK_RGB_UNDERGLOW_EFFECT(custom_capslock_white, custom_effect_update);
```

## src/viera_led_bridge.c
```c
// SPDX-License-Identifier: MIT
#include <zephyr/kernel.h>
#include <zephyr/init.h>
#include <zephyr/logging/log.h>
#include <zephyr/sys/atomic.h>
#include <zephyr/sys/util.h>
#include <stdlib.h>
#include <viera_effects.h>

LOG_MODULE_REGISTER(viera_led_bridge, CONFIG_LOG_DEFAULT_LEVEL);

#define VIERA_FADE_TOTAL_MS 250
#define VIERA_FADE_STEP_MS 16

#define ZMK_BRT_MAX 100

static atomic_t g_target_brt = ATOMIC_INIT(10);
static atomic_t g_current_brt = ATOMIC_INIT(10);

/* Last-written RGB cache so GATT reads return exactly what the host wrote.
 * Stored as 0xRRGGBB; sentinel -1 means uninitialized (lazy-seed from HSB).
 */
static atomic_t g_color_cache = ATOMIC_INIT(-1);

static void viera_brightness_fade_work(struct k_work *work);
static struct k_work_delayable g_fade_work;

static inline uint8_t clamp_0_100(int v) {
    if (v < 0) {
        return 0;
    }
    if (v > 100) {
        return 100;
    }
    return (uint8_t)v;
}

uint8_t viera_user_brightness_get(void) {
    return (uint8_t)atomic_get(&g_current_brt);
}

static void viera_user_brightness_set_target(uint8_t v) {
    v = clamp_0_100(v);
    atomic_set(&g_target_brt, v);
    (void)k_work_reschedule(&g_fade_work, K_NO_WAIT);
}

#if IS_ENABLED(CONFIG_ZMK_RGB_UNDERGLOW)
#include <zmk/rgb_underglow.h>
#endif

static void viera_brightness_fade_work(struct k_work *work) {
    ARG_UNUSED(work);

    int curr = atomic_get(&g_current_brt);
    int target = atomic_get(&g_target_brt);

    if (curr == target) {
        return;
    }

    int diff = target - curr;
    int steps = MAX(1, VIERA_FADE_TOTAL_MS / VIERA_FADE_STEP_MS);
    int step_mag = MAX(1, abs(diff) / steps);
    int next = curr + (diff > 0 ? step_mag : -step_mag);

    if ((diff > 0 && next > target) || (diff < 0 && next < target)) {
        next = target;
    }

    atomic_set(&g_current_brt, clamp_0_100(next));

#if IS_ENABLED(CONFIG_ZMK_RGB_UNDERGLOW)
    struct zmk_led_hsb c = zmk_rgb_underglow_get_hsb();
    int b = (atomic_get(&g_current_brt) * ZMK_BRT_MAX) / 100;
    c.b = (uint8_t)MIN(b, ZMK_BRT_MAX);
    (void)zmk_rgb_underglow_set_hsb(c);
    zmk_rgb_underglow_request_refresh();
#endif

    if (next != target) {
        (void)k_work_reschedule(&g_fade_work, K_MSEC(VIERA_FADE_STEP_MS));
    }
}

void viera_on_backlight_power_changed(uint8_t on) {
#if IS_ENABLED(CONFIG_ZMK_RGB_UNDERGLOW)
    if (on) {
        (void)zmk_rgb_underglow_on();
        struct zmk_led_hsb c = zmk_rgb_underglow_get_hsb();
        int b = (atomic_get(&g_current_brt) * ZMK_BRT_MAX) / 100;
        c.b = (uint8_t)MIN(b, ZMK_BRT_MAX);
        (void)zmk_rgb_underglow_set_hsb(c);
        zmk_rgb_underglow_request_refresh();
    } else {
        (void)zmk_rgb_underglow_off();
    }
#else
    ARG_UNUSED(on);
#endif
}

void viera_on_brightness_changed(uint8_t level) {
    viera_user_brightness_set_target(level);
}

void viera_on_effect_changed(uint8_t effect) {
#if IS_ENABLED(CONFIG_ZMK_RGB_UNDERGLOW)
    if (effect >= VIERA_EFF_NUMBER) {
        return;
    }
    (void)zmk_rgb_underglow_on();
    (void)zmk_rgb_underglow_select_effect((int)effect);
    zmk_rgb_underglow_request_refresh();
#endif
}

static void rgb_to_hsb(uint8_t r, uint8_t g, uint8_t b, uint16_t *h, uint8_t *s, uint8_t *br) {
    int max_c = MAX(r, MAX(g, b));
    int min_c = MIN(r, MIN(g, b));
    int delta = max_c - min_c;

    *br = (uint8_t)((max_c * 100) / 255);

    if (max_c == 0 || delta == 0) {
        *s = 0;
        *h = 0;
        return;
    }

    *s = (uint8_t)((delta * 100) / max_c);

    int hue;
    if (max_c == r) {
        hue = ((g - b) * 60) / delta;
        if (hue < 0) hue += 360;
    } else if (max_c == g) {
        hue = 120 + ((b - r) * 60) / delta;
    } else {
        hue = 240 + ((r - g) * 60) / delta;
    }
    *h = (uint16_t)hue;
}

static inline int pack_rgb(uint8_t r, uint8_t g, uint8_t b) {
    return ((int)r << 16) | ((int)g << 8) | (int)b;
}

#if IS_ENABLED(CONFIG_ZMK_RGB_UNDERGLOW)
static void hsb_to_rgb(uint16_t h, uint8_t s, uint8_t br,
                       uint8_t *r, uint8_t *g, uint8_t *b) {
    /* h: 0..359, s: 0..100, br: 0..100 */
    if (h >= 360) h %= 360;
    if (s > 100) s = 100;
    if (br > 100) br = 100;

    int v = (br * 255) / 100;
    if (s == 0) {
        *r = *g = *b = (uint8_t)v;
        return;
    }
    int region = h / 60;
    int remainder = (h - region * 60) * 255 / 60;
    int p = (v * (255 - s * 255 / 100)) / 255;
    int q = (v * (255 - (s * remainder) / 100)) / 255;
    int t = (v * (255 - (s * (255 - remainder)) / 100)) / 255;

    int rr = 0, gg = 0, bb = 0;
    switch (region) {
    case 0: rr = v; gg = t; bb = p; break;
    case 1: rr = q; gg = v; bb = p; break;
    case 2: rr = p; gg = v; bb = t; break;
    case 3: rr = p; gg = q; bb = v; break;
    case 4: rr = t; gg = p; bb = v; break;
    default: rr = v; gg = p; bb = q; break;
    }
    *r = (uint8_t)CLAMP(rr, 0, 255);
    *g = (uint8_t)CLAMP(gg, 0, 255);
    *b = (uint8_t)CLAMP(bb, 0, 255);
}
#endif

void viera_on_color_changed(uint8_t r, uint8_t g, uint8_t b) {
    atomic_set(&g_color_cache, pack_rgb(r, g, b));
#if IS_ENABLED(CONFIG_ZMK_RGB_UNDERGLOW)
    uint16_t h;
    uint8_t s, br;
    rgb_to_hsb(r, g, b, &h, &s, &br);

    struct zmk_led_hsb c = zmk_rgb_underglow_get_hsb();
    c.h = h;
    c.s = s;
    (void)zmk_rgb_underglow_set_hsb(c);
    zmk_rgb_underglow_request_refresh();
    LOG_DBG("Color RGB(%u,%u,%u) -> HSB(%u,%u,%u)", r, g, b, h, s, br);
#endif
}

void viera_on_speed_changed(uint8_t speed) {
#if IS_ENABLED(CONFIG_ZMK_RGB_UNDERGLOW)
    (void)zmk_rgb_underglow_set_speed(speed);
    zmk_rgb_underglow_request_refresh();
    LOG_DBG("Speed -> %u", speed);
#endif
}

/* -------- Read-side getters consumed by viera_gatt.c -------- */

int viera_get_power(uint8_t *out) {
#if IS_ENABLED(CONFIG_ZMK_RGB_UNDERGLOW)
    *out = zmk_rgb_underglow_is_on() ? 1 : 0;
    return 0;
#else
    ARG_UNUSED(out);
    return -ENOTSUP;
#endif
}

int viera_get_brightness(uint8_t *out) {
    /* Return the last user-requested level (target), so a write immediately
     * round-trips through a read even mid-fade. */
    int v = atomic_get(&g_target_brt);
    *out = clamp_0_100(v);
    return 0;
}

int viera_get_effect(uint8_t *out) {
#if IS_ENABLED(CONFIG_ZMK_RGB_UNDERGLOW)
    *out = zmk_rgb_underglow_get_effect();
    return 0;
#else
    ARG_UNUSED(out);
    return -ENOTSUP;
#endif
}

int viera_get_color(uint8_t out[3]) {
    int v = atomic_get(&g_color_cache);
#if IS_ENABLED(CONFIG_ZMK_RGB_UNDERGLOW)
    if (v < 0) {
        /* Lazy seed: derive RGB from the persisted HSB so the first read
         * after boot reflects real state. We synthesize at full brightness
         * because the host's color slider is independent of the brightness
         * slider; the user_brightness path already handles dimming. */
        struct zmk_led_hsb c = zmk_rgb_underglow_get_hsb();
        uint8_t r, g, b;
        hsb_to_rgb(c.h, c.s, 100, &r, &g, &b);
        v = pack_rgb(r, g, b);
        atomic_set(&g_color_cache, v);
    }
#else
    if (v < 0) {
        v = pack_rgb(255, 255, 255);
    }
#endif
    out[0] = (uint8_t)((v >> 16) & 0xFF);
    out[1] = (uint8_t)((v >> 8) & 0xFF);
    out[2] = (uint8_t)(v & 0xFF);
    return 0;
}

int viera_get_speed(uint8_t *out) {
#if IS_ENABLED(CONFIG_ZMK_RGB_UNDERGLOW)
    uint8_t s = zmk_rgb_underglow_get_speed();
    if (s < 1) s = 1;
    if (s > 5) s = 5;
    *out = s;
    return 0;
#else
    ARG_UNUSED(out);
    return -ENOTSUP;
#endif
}

#if IS_ENABLED(CONFIG_ZMK_RGB_UNDERGLOW)
static void viera_startup_effect_work(struct k_work *work) {
    ARG_UNUSED(work);
    struct zmk_led_hsb c = zmk_rgb_underglow_get_hsb();
    int b = (atomic_get(&g_current_brt) * ZMK_BRT_MAX) / 100;
    c.b = (uint8_t)MIN(b, ZMK_BRT_MAX);
    (void)zmk_rgb_underglow_set_hsb(c);
#if IS_ENABLED(CONFIG_ZMK_RGB_UNDERGLOW_VIERA_MIRROR_FILL)
    (void)zmk_rgb_underglow_select_effect(VIERA_EFF_MIRROR_FILL);
#else
    (void)zmk_rgb_underglow_select_effect(VIERA_EFF_SWIRL);
#endif
    zmk_rgb_underglow_request_refresh();
}
static K_WORK_DELAYABLE_DEFINE(g_startup_work, viera_startup_effect_work);
#endif

static int viera_led_bridge_init(void) {
    k_work_init_delayable(&g_fade_work, viera_brightness_fade_work);
#if IS_ENABLED(CONFIG_ZMK_RGB_UNDERGLOW)
    k_work_schedule(&g_startup_work, K_MSEC(50));
#endif
    return 0;
}
SYS_INIT(viera_led_bridge_init, APPLICATION, 50);
```

## src/viera_led_state.c
```c
#include <zephyr/sys/atomic.h>
#include "viera_led_state.h"

static atomic_t g_user_brt = ATOMIC_INIT(80); // 0..100
uint8_t viera_user_brightness_get(void) { return (uint8_t)atomic_get(&g_user_brt); }
void viera_user_brightness_set(uint8_t v) { if (v > 100) v = 100; atomic_set(&g_user_brt, v); }

void viera_on_brightness_changed(uint8_t level) {
    if (level > 100) level = 100;
    viera_user_brightness_set(level);
#if IS_ENABLED(CONFIG_ZMK_RGB_UNDERGLOW)
    zmk_rgb_underglow_set_brt(level);
    zmk_rgb_underglow_resume();
#endif
}
```
